## kloudos/config/remove_non_amd_defconfig
```kconfig
CONFIG_NOUVEAU_LEGACY_CTX_SUPPORT=n
CONFIG_NOUVEAU_DEBUG=5
CONFIG_NOUVEAU_DEBUG_DEFAULT=3
CONFIG_NOUVEAU_DEBUG_MMU=n
CONFIG_DRM_NOUVEAU_BACKLIGHT=n
CONFIG_DRM_NOUVEAU_SVM=n
CONFIG_DRM_NOUVEAU=n
CONFIG_FB_INTEL=n
CONFIG_FB_INTEL_DEBUG=n
CONFIG_FB_INTEL_I2C=n
CONFIG_SND_HDA_INTEL=n
CONFIG_SND_INTEL8X0=n
CONFIG_SND_INTEL8X0M=n
CONFIG_SND_INTEL_NHLT=n
CONFIG_SND_INTEL_DSP_CONFIG=n
CONFIG_SND_SOC_INTEL_SKYLAKE=n
CONFIG_SND_SOC_INTEL_SKL=n
CONFIG_SND_SOC_INTEL_APL=n
CONFIG_SND_SOC_INTEL_KBL=n
CONFIG_SND_SOC_INTEL_GLK=n
CONFIG_SND_SOC_INTEL_CNL=n
CONFIG_SND_SOC_INTEL_CFL=n
CONFIG_SND_SOC_INTEL_CML_H=n
CONFIG_SND_SOC_INTEL_CML_LP=n
CONFIG_SND_SOC_INTEL_SKYLAKE_FAMILY=n
CONFIG_SND_SOC_INTEL_SKYLAKE_SSP_CLK=n
CONFIG_SND_SOC_INTEL_SKYLAKE_HDAUDIO_CODEC=n
CONFIG_SND_SOC_INTEL_SKYLAKE_COMMON=n
CONFIG_SND_SOC_ACPI_INTEL_MATCH=n
CONFIG_SND_SOC_INTEL_MACH=n
CONFIG_SND_SOC_INTEL_USER_FRIENDLY_LONG_NAMES=n
CONFIG_SND_SOC_INTEL_HASWELL_MACH=n
CONFIG_SND_SOC_INTEL_BDW_RT5650_MACH=n
CONFIG_SND_SOC_INTEL_BDW_RT5677_MACH=n
CONFIG_SND_SOC_INTEL_BROADWELL_MACH=n
CONFIG_SND_SOC_INTEL_BYTCR_RT5640_MACH=n
CONFIG_SND_SOC_INTEL_BYTCR_RT5651_MACH=n
CONFIG_SND_SOC_INTEL_CHT_BSW_RT5672_MACH=n
CONFIG_SND_SOC_INTEL_CHT_BSW_RT5645_MACH=n
CONFIG_SND_SOC_INTEL_CHT_BSW_MAX98090_TI_MACH=n
CONFIG_SND_SOC_INTEL_CHT_BSW_NAU8824_MACH=n
CONFIG_SND_SOC_INTEL_BYT_CHT_CX2072X_MACH=n
CONFIG_SND_SOC_INTEL_BYT_CHT_DA7213_MACH=n
CONFIG_SND_SOC_INTEL_BYT_CHT_ES8316_MACH=n
CONFIG_SND_SOC_INTEL_BYT_CHT_NOCODEC_MACH=n
CONFIG_SND_SOC_INTEL_SKL_RT286_MACH=n
CONFIG_SND_SOC_INTEL_SKL_NAU88L25_SSM4567_MACH=n
CONFIG_SND_SOC_INTEL_SKL_NAU88L25_MAX98357A_MACH=n
CONFIG_SND_SOC_INTEL_DA7219_MAX98357A_GENERIC=n
CONFIG_SND_SOC_INTEL_BXT_DA7219_MAX98357A_COMMON=n
CONFIG_SND_SOC_INTEL_BXT_DA7219_MAX98357A_MACH=n
CONFIG_SND_SOC_INTEL_BXT_RT298_MACH=n
CONFIG_SND_SOC_INTEL_SOF_WM8804_MACH=n
CONFIG_SND_SOC_INTEL_KBL_RT5663_MAX98927_MACH=n
CONFIG_SND_SOC_INTEL_KBL_RT5663_RT5514_MAX98927_MACH=n
CONFIG_SND_SOC_INTEL_KBL_DA7219_MAX98357A_MACH=n
CONFIG_SND_SOC_INTEL_KBL_DA7219_MAX98927_MACH=n
CONFIG_SND_SOC_INTEL_KBL_RT5660_MACH=n
CONFIG_SND_SOC_INTEL_GLK_DA7219_MAX98357A_MACH=n
CONFIG_SND_SOC_INTEL_GLK_RT5682_MAX98357A_MACH=n
CONFIG_SND_SOC_INTEL_SKL_HDA_DSP_GENERIC_MACH=n
CONFIG_SND_SOC_INTEL_SOF_RT5682_MACH=n
CONFIG_SND_SOC_INTEL_SOF_PCM512x_MACH=n
CONFIG_SND_SOC_INTEL_CML_LP_DA7219_MAX98357A_MACH=n
CONFIG_SND_SOC_INTEL_SOF_CML_RT1011_RT5682_MACH=n
CONFIG_SND_SOC_INTEL_SOF_DA7219_MAX98373_MACH=n
CONFIG_SND_SOC_INTEL_EHL_RT5660_MACH=n
CONFIG_SND_SOC_INTEL_SST_ACPI=n
CONFIG_SND_SOC_INTEL_SST=n
CONFIG_SND_SOC_INTEL_SST_FIRMWARE=n
CONFIG_SND_SOC_INTEL_HASWELL=n
CONFIG_SND_SOC_INTEL_SST_TOPLEVEL=n
CONFIG_SND_SOC_SOF_INTEL_TOPLEVEL=n
CONFIG_SND_SOC_SOF_INTEL_ACPI=n
CONFIG_SND_SOC_SOF_INTEL_PCI=n
CONFIG_SND_SOC_SOF_INTEL_HIFI_EP_IPC=n
CONFIG_SND_SOC_SOF_INTEL_ATOM_HIFI_EP=n
CONFIG_SND_SOC_SOF_INTEL_COMMON=n
CONFIG_SND_SOC_SOF_INTEL_SOUNDWIRE_LINK=n
CONFIG_SND_SOC_SOF_INTEL_SOUNDWIRE_LINK_BASELINE=n
CONFIG_INTEL_ISH_HID=n
CONFIG_INTEL_ISH_FIRMWARE_DOWNLOADER=n
CONFIG_TYPEC_MUX_INTEL_PMC=n
CONFIG_USB_ROLES_INTEL_XHCI=n
CONFIG_LEDS_INTEL_SS4200=n
CONFIG_INTEL_IDMA64=n
CONFIG_INTEL_IDXD=n
CONFIG_INTEL_IOATDMA=n
CONFIG_INTEL_MIC_X100_DMA=n
CONFIG_INTEL_ATOMISP=n
CONFIG_INTEL_WMI_SBL_FW_UPDATE=n
CONFIG_INTEL_WMI_THUNDERBOLT=n
CONFIG_INTEL_SPEED_SELECT_INTERFACE=n
CONFIG_INTEL_TURBO_MAX_3=n
CONFIG_INTEL_UNCORE_FREQ_CONTROL=n
CONFIG_INTEL_BXTWC_PMIC_TMU=n
CONFIG_INTEL_CHTDC_TI_PWRBTN=n
CONFIG_INTEL_MFLD_THERMAL=n
CONFIG_INTEL_MID_POWER_BUTTON=n
CONFIG_INTEL_MRFLD_PWRBTN=n
CONFIG_INTEL_PMC_CORE=n
CONFIG_INTEL_PUNIT_IPC=n
CONFIG_INTEL_SCU_IPC=n
CONFIG_INTEL_SCU=n
CONFIG_INTEL_SCU_PCI=n
CONFIG_INTEL_SCU_PLATFORM=n
CONFIG_INTEL_SCU_IPC_UTIL=n
CONFIG_INTEL_TELEMETRY=n
CONFIG_INTEL_IPS=n
CONFIG_INTEL_RST=n
CONFIG_INTEL_SMARTCONNECT=n
CONFIG_INTEL_CHT_INT33FE=n
CONFIG_INTEL_HID_EVENT=n
CONFIG_INTEL_INT0002_VGPIO=n
CONFIG_INTEL_MENLOW=n
CONFIG_INTEL_OAKTRAIL=n
CONFIG_INTEL_VBTN=n
CONFIG_INTEL_IOMMU=n
CONFIG_INTEL_IOMMU_SVM=n
CONFIG_INTEL_IOMMU_DEFAULT_ON=n
CONFIG_INTEL_IOMMU_FLOPPY_WA=n
CONFIG_INTEL_IOMMU_SCALABLE_MODE_DEFAULT_ON=n
CONFIG_SOUNDWIRE_INTEL=n
CONFIG_EXTCON_INTEL_INT3496=n
CONFIG_EXTCON_INTEL_CHT_WC=n
CONFIG_EXTCON_INTEL_MRFLD=n
CONFIG_INTEL_MRFLD_ADC=n
CONFIG_INTEL_TH=n
CONFIG_INTEL_TH_PCI=n
CONFIG_INTEL_TH_ACPI=n
CONFIG_INTEL_TH_GTH=n
CONFIG_INTEL_TH_STH=n
CONFIG_INTEL_TH_MSU=n
CONFIG_INTEL_TH_PTI=n
CONFIG_INTEL_RAPL_CORE=n
CONFIG_INTEL_RAPL=n
CONFIG_PHY_INTEL_EMMC=n
CONFIG_NTB_INTEL=n
CONFIG_INTEL_TH_DEBUG=n
CONFIG_INTEL_TXT=n
CONFIG_X86_INTEL_MID=n
CONFIG_X86_INTEL_LPSS=n
CONFIG_HAVE_INTEL_TXT=n
CONFIG_CRYPTO_AES_NI_INTEL=n
CONFIG_CRYPTO_GHASH_CLMUL_NI_INTEL=n
CONFIG_CRYPTO_CRC32C_INTEL=n
CONFIG_X86_INTEL_MEMORY_PROTECTION_KEYS=n
CONFIG_X86_INTEL_TSX_MODE_OFF=n
CONFIG_X86_INTEL_TSX_MODE_ON=n
CONFIG_X86_INTEL_TSX_MODE_AUTO=n
CONFIG_MICROCODE_INTEL=n
CONFIG_PERF_EVENTS_INTEL_UNCORE=n
CONFIG_PERF_EVENTS_INTEL_RAPL=n
CONFIG_PERF_EVENTS_INTEL_CSTATE=n
CONFIG_X86_MCE_INTEL=n
CONFIG_CPU_SUP_INTEL=n
CONFIG_INTEL_IDLE=n
CONFIG_X86_INTEL_PSTATE=n
CONFIG_KVM_INTEL=n
CONFIG_BT_HCIUART_INTEL=n
CONFIG_BT_INTEL=n
CONFIG_MTD_INTEL_VR_NOR=n
CONFIG_MTD_CFI_INTELEXT=n
CONFIG_SPI_INTEL_SPI_PCI=n
CONFIG_SPI_INTEL_SPI_PLATFORM=n
CONFIG_INTEL_MIC_HOST=n
CONFIG_INTEL_MIC_CARD=n
CONFIG_INTEL_MIC_BUS=n
CONFIG_INTEL_MEI=n
CONFIG_INTEL_MEI_ME=n
CONFIG_INTEL_MEI_TXE=n
CONFIG_INTEL_MEI_HDCP=n
CONFIG_NET_VENDOR_INTEL=n
CONFIG_DWMAC_INTEL=n
CONFIG_PINCTRL_INTEL=n
CONFIG_HW_RANDOM_INTEL=n
CONFIG_MOXA_INTELLIO=n
CONFIG_WLAN_VENDOR_INTEL=n
CONFIG_INTEL_XWAY_PHY=n
CONFIG_INTEL_GTT=n
CONFIG_AGP_INTEL=n
CONFIG_INTEL_BXT_PMIC_THERMAL=n
CONFIG_INTEL_PCH_THERMAL=n
CONFIG_INTEL_POWERCLAMP=n
CONFIG_INTEL_SOC_DTS_IOSF_CORE=n
CONFIG_INTEL_SOC_DTS_THERMAL=n
CONFIG_INTEL_MEI_WDT=n
CONFIG_INTEL_SOC_PMIC=n
CONFIG_INTEL_SOC_PMIC_BXTWC=n
CONFIG_INTEL_SOC_PMIC_CHTWC=n
CONFIG_INTEL_SOC_PMIC_CHTDC_TI=n
CONFIG_INTEL_SOC_PMIC_MRFLD=n
CONFIG_MFD_INTEL_QUARK_I2C_GPIO=n
CONFIG_MFD_INTEL_LPSS=n
CONFIG_MFD_INTEL_LPSS_ACPI=n
CONFIG_MFD_INTEL_LPSS_PCI=n
CONFIG_MFD_INTEL_MSIC=n
CONFIG_MFD_INTEL_PMC_BXT=n
CONFIG_MALI_VALHALL_REAL_HW=n
CONFIG_XZ_DEC_ARM=n
CONFIG_XZ_DEC_ARMTHUMB=n
CONFIG_USB_ARMLINUX=n
```

## kloudos/config/remove_non_intel_defconfig
```kconfig
CONFIG_X86_AMD_PLATFORM_DEVICE=n
CONFIG_CPU_SUP_AMD=n
CONFIG_X86_MCE_AMD=n
CONFIG_PERF_EVENTS_AMD_POWER=n
CONFIG_MICROCODE_AMD=n
CONFIG_AMD_MEM_ENCRYPT=n
CONFIG_AMD_NUMA=n
CONFIG_X86_AMD_FREQ_SENSITIVITY=n
CONFIG_AMD_NB=n
CONFIG_KVM_AMD=n
CONFIG_KVM_AMD_SEV=n
CONFIG_MTD_AMD76XROM=n
CONFIG_MTD_CFI_AMDSTD=n
CONFIG_HSA_AMD=n
CONFIG_DRM_AMD_DC=n
CONFIG_DRM_AMD_DC_DCN=n
CONFIG_DRM_AMD_DC_HDCP=n
CONFIG_DRM_AMD_ACP=n
CONFIG_DRM_AMDGPU=n
CONFIG_DRM_AMDGPU_SI=n
CONFIG_DRM_AMDGPU_CIK=n
CONFIG_DRM_AMDGPU_USERPTR=n
CONFIG_DRM_AMDGPU_GART_DEBUGFS=n
CONFIG_AGP_AMD64=n
CONFIG_SENSORS_AMD_ENERGY=n
CONFIG_GPIO_AMD8111=n
CONFIG_GPIO_AMD_FCH=n
CONFIG_GPIO_AMDPT=n
CONFIG_PINCTRL_AMD=n
CONFIG_SPI_AMD=n
CONFIG_I2C_AMD756=n
CONFIG_I2C_AMD756_S4882=n
CONFIG_I2C_AMD8111=n
CONFIG_I2C_AMD_MP2=n
CONFIG_HW_RANDOM_AMD=n
CONFIG_AMD_PHY=n
CONFIG_AMD_XGBE=n
CONFIG_AMD_XGBE_DCB=n
CONFIG_AMD_XGBE_HAVE_ECC=n
CONFIG_NET_VENDOR_AMD=n
CONFIG_PATA_AMD=n
CONFIG_AMD8111_ETH=n
CONFIG_DRM_NOUVEAU=n
CONFIG_SND_SOC_AMD_ACP=n
CONFIG_SND_SOC_AMD_CZ_DA7219MX98357_MACH=n
CONFIG_SND_SOC_AMD_CZ_RT5645_MACH=n
CONFIG_SND_SOC_AMD_ACP3x=n
CONFIG_SND_SOC_AMD_RV_RT5682_MACH=n
CONFIG_SND_SOC_AMD_RENOIR=n
CONFIG_SND_SOC_AMD_RENOIR_MACH=n
CONFIG_EDAC_AMD64=n
CONFIG_EDAC_AMD64_ERROR_INJECTION=n
CONFIG_NTB_AMD=n
CONFIG_NOUVEAU_LEGACY_CTX_SUPPORT=n
CONFIG_NOUVEAU_DEBUG=5
CONFIG_NOUVEAU_DEBUG_DEFAULT=3
CONFIG_NOUVEAU_DEBUG_MMU=n
CONFIG_DRM_NOUVEAU_BACKLIGHT=n
CONFIG_DRM_NOUVEAU_SVM=n
CONFIG_USB_AMD5536UDC=n
CONFIG_AMD_IOMMU=n
CONFIG_AMD_IOMMU_V2=n
CONFIG_AMDTEE=n
CONFIG_X86_AMD_PLATFORM_DEVICE=n
CONFIG_AMD_MEM_ENCRYPT_ACTIVE_BY_DEFAULT=n
```
