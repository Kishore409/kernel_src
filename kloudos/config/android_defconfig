## kloudos/config/android_defconfig
```kconfig
CONFIG_ASHMEM=y
CONFIG_ANDROID=y
CONFIG_ANDROID_BINDER_IPC=y
# CONFIG_ANDROID_VSOC is not set
CONFIG_ION=y
CONFIG_ION_SYSTEM_HEAP=y
```

## kloudos/config/common_arm_defconfig
```kconfig
CONFIG_REGULATOR_VCTRL=m
CONFIG_SC_DISPCC_7180=y
CONFIG_SC_GPUCC_7180=y
CONFIG_SC_VIDEOCC_7180=y
CONFIG_DRM_PANEL_BOE_TV101WUM_NL6=y
CONFIG_MTK_SCP=m
CONFIG_SND_SOC_MT8183_DA7219_MAX98357A=y
CONFIG_QCOM_WDT=y
CONFIG_QCOM_SOCINFO=y
CONFIG_INTERCONNECT_QCOM_SC7180=y
CONFIG_INTERCONNECT_QCOM_OSM_L3=y
CONFIG_SERIAL_8250=n
CONFIG_SERIAL_8250_CONSOLE=n
CONFIG_SERIAL_OF_PLATFORM=n
CONFIG_QCOM_IPA=m
CONFIG_SC_MSS_7180=m
CONFIG_TYPEC=m
CONFIG_MALI_VALHALL=y
CONFIG_MALI_VALHALL_DMA_FENCE=y
CONFIG_MALI_VALHALL_EXPERT=y
CONFIG_DRM_PANEL_VISIONOX_RM69299=y
CONFIG_RTW88=m
CONFIG_RTW88_8822BE=y
CONFIG_RTW88_8822CE=y
CONFIG_XZ_DEC_ARM=y
CONFIG_XZ_DEC_ARMTHUMB=y
CONFIG_USB_ARMLINUX=y
```

## kloudos/config/common_defconfig
```kconfig
CONFIG_DEFAULT_HOSTNAME="kloudos"
CONFIG_CC_VERSION_TEXT="gcc (KloudOS 9.3.0-17KloudOS~0.01) 9.3.0"
CONFIG_LOW_MEM_NOTIFY=y
CONFIG_SWAP=y
CONFIG_DISK_BASED_SWAP=y
CONFIG_INIT_STACK_NONE=n
CONFIG_INIT_STACK_ALL=y

# SELINUX
CONFIG_LSM="yama,loadpin,integrity,selinux"
CONFIG_DEFAULT_SECURITY_SELINUX=y
# CONFIG_SECURITY_SELINUX_DISABLE is not set
CONFIG_SECURITY_SELINUX_DEVELOP=y
CONFIG_SECURITY_SELINUX_AVC_STATS=y
CONFIG_SECURITY_SELINUX_CHECKREQPROT_VALUE=1
CONFIG_DEBUG_KERNEL=n
CONFIG_DEBUG_MISC=n
CONFIG_DEBUG_FS=n
CONFIG_KPROBES=n
CONFIG_DEBUG_INFO=n
CONFIG_KALLSYMS=n
CONFIG_KALLSYMS_ALL=n
CONFIG_BLK_DEBUG_FS=n
CONFIG_BLK_DEBUG_FS_ZONED=n
CONFIG_L2TP_DEBUGFS=n
CONFIG_BT_DEBUGFS=n
CONFIG_MAC80211_DEBUGFS=n
CONFIG_CFG80211_DEBUGFS=n
CONFIG_CB710_DEBUG_ASSUMPTIONS=n
CONFIG_SCSI_DEBUG=n
CONFIG_MLX4_DEBUG=n
CONFIG_ATH10K_DEBUGFS=n
CONFIG_WIL6210_DEBUGFS=n
CONFIG_ATH9K_HTC_DEBUGFS=n
CONFIG_ATH9K_DEBUGFS=n
CONFIG_ATH9K_COMMON_DEBUG=n
CONFIG_IWLEGACY_DEBUGFS=n
CONFIG_IWLWIFI_DEBUGFS=n
CONFIG_RTW88_DEBUG=n
CONFIG_RTW88_DEBUGFS=n
CONFIG_IEEE802154_CA8210_DEBUGFS=n
CONFIG_IEEE802154_AT86RF230_DEBUGFS=n
CONFIG_SMS_SIANO_DEBUGFS=n
CONFIG_USB_SERIAL_DEBUG=n
CONFIG_WILCO_EC_DEBUGFS=n
CONFIG_CROS_EC_DEBUGFS=n
CONFIG_NFS_DEBUG=n
CONFIG_SUNRPC_DEBUG=n
CONFIG_CIFS_DEBUG=n
CONFIG_SYMBOLIC_ERRNAME=n
CONFIG_DEBUG_BUGVERBOSE=n
CONFIG_DYNAMIC_DEBUG=n
CONFIG_PAGE_POISONING=n
CONFIG_PAGE_POISONING_NO_SANITY=n
CONFIG_PAGE_POISONING_ZERO=n
# CONFIG_DEBUG_RODATA_TEST is not set
CONFIG_ARCH_HAS_DEBUG_WX=n
CONFIG_DEBUG_WX=n
CONFIG_GENERIC_PTDUMP=n
CONFIG_PTDUMP_CORE=n
# CONFIG_SLUB_DEBUG_ON is not set
# CONFIG_SLUB_STATS is not set
CONFIG_HAVE_DEBUG_KMEMLEAK=n
CONFIG_ARCH_HAS_DEBUG_VM_PGTABLE=n
# CONFIG_DEBUG_VM_PGTABLE is not set
CONFIG_ARCH_HAS_DEBUG_VIRTUAL=n
# CONFIG_DEBUG_MEMORY_INIT is not set
CONFIG_HAVE_ARCH_KASAN=n
CONFIG_HAVE_ARCH_KASAN_VMALLOC=n
CONFIG_CC_HAS_KASAN_GENERIC=n
CONFIG_CC_HAS_WORKING_NOSANITIZE_ADDRESS=n
# CONFIG_KASAN is not set
CONFIG_KASAN_STACK=0
CONFIG_TRACE_IRQFLAGS_SUPPORT=n
CONFIG_EARLY_PRINTK_USB=n
CONFIG_X86_VERBOSE_BOOTUP=n
CONFIG_EARLY_PRINTK=n
CONFIG_EARLY_PRINTK_DBGP=n
CONFIG_EARLY_PRINTK_USB_XDBC=n
CONFIG_EFI_PGT_DUMP=n
CONFIG_HAVE_MMIOTRACE_SUPPORT=n
CONFIG_IO_DELAY_0X80=y
CONFIG_IO_DELAY_0XED=n
CONFIG_IO_DELAY_UDELAY=n
CONFIG_IO_DELAY_NONE=n
CONFIG_PUNIT_ATOM_DEBUG=n
CONFIG_UNWINDER_ORC=n
CONFIG_UNWINDER_FRAME_POINTER=n
# CONFIG_UNWINDER_GUESS is not set
CONFIG_DEBUG_BUGVERBOSE=n
CONFIG_DYNAMIC_DEBUG_CORE=n
CONFIG_CB710_DEBUG_ASSUMPTIONS=n
CONFIG_PM_DEBUG=n
CONFIG_PM_ADVANCED_DEBUG=n
CONFIG_PM_SLEEP_DEBUG=n
CONFIG_ACPI_EC_DEBUGFS=n
CONFIG_ACPI_DEBUGGER=n
CONFIG_ACPI_DEBUGGER_USER=n
CONFIG_ACPI_DEBUG=n
CONFIG_SLUB_DEBUG=n
CONFIG_IOSF_MBI_DEBUG=n
CONFIG_ARCH_SUPPORTS_DEBUG_PAGEALLOC=n
CONFIG_X86_DEBUGCTLMSR=n
CONFIG_PRINTK_TIME=n
CONFIG_DEBUG_BUGVERBOSE=n
CONFIG_MEMTEST=n
CONFIG_ARCH_HAS_KCOV=n
CONFIG_CC_HAS_SANCOV_TRACE_PC=n
CONFIG_TEST_BPF=n
CONFIG_TEST_BLACKHOLE_DEV=n
CONFIG_RUNTIME_TESTING_MENU=n
CONFIG_NOTIFIER_ERROR_INJECTION=n
CONFIG_PM_NOTIFIER_ERROR_INJECT=n
CONFIG_X86_DEBUG_FPU=n
```

## kloudos/config/debug_defconfig
```kconfig
CONFIG_DEBUG_KERNEL=y
CONFIG_DEBUG_MISC=y
CONFIG_DEBUG_FS=y
CONFIG_KPROBES=y
CONFIG_DEBUG_INFO=y
CONFIG_KALLSYMS=y
CONFIG_KALLSYMS_ALL=y
CONFIG_BLK_DEBUG_FS=y
CONFIG_BLK_DEBUG_FS_ZONED=y
CONFIG_L2TP_DEBUGFS=m
CONFIG_BT_DEBUGFS=y
CONFIG_MAC80211_DEBUGFS=y
CONFIG_CFG80211_DEBUGFS=y
CONFIG_CB710_DEBUG_ASSUMPTIONS=y
CONFIG_SCSI_DEBUG=m
CONFIG_MLX4_DEBUG=y
CONFIG_ATH10K_DEBUGFS=y
CONFIG_WIL6210_DEBUGFS=y
CONFIG_ATH9K_HTC_DEBUGFS=y
CONFIG_ATH9K_DEBUGFS=y
CONFIG_ATH9K_COMMON_DEBUG=y
CONFIG_IWLEGACY_DEBUGFS=y
CONFIG_IWLWIFI_DEBUGFS=y
CONFIG_RTW88_DEBUG=y
CONFIG_RTW88_DEBUGFS=y
CONFIG_IEEE802154_CA8210_DEBUGFS=y
CONFIG_IEEE802154_AT86RF230_DEBUGFS=y
CONFIG_SMS_SIANO_DEBUGFS=y
CONFIG_USB_SERIAL_DEBUG=m
CONFIG_WILCO_EC_DEBUGFS=m
CONFIG_CROS_EC_DEBUGFS=m
CONFIG_NFS_DEBUG=y
CONFIG_SUNRPC_DEBUG=y
CONFIG_CIFS_DEBUG=y
CONFIG_SYMBOLIC_ERRNAME=y
CONFIG_DEBUG_BUGVERBOSE=y
CONFIG_DYNAMIC_DEBUG=y
CONFIG_PAGE_POISONING=y
CONFIG_PAGE_POISONING_NO_SANITY=y
CONFIG_PAGE_POISONING_ZERO=y
# CONFIG_DEBUG_RODATA_TEST is not set
CONFIG_ARCH_HAS_DEBUG_WX=y
CONFIG_DEBUG_WX=y
CONFIG_GENERIC_PTDUMP=y
CONFIG_PTDUMP_CORE=y
# CONFIG_SLUB_DEBUG_ON is not set
# CONFIG_SLUB_STATS is not set
CONFIG_HAVE_DEBUG_KMEMLEAK=y
CONFIG_ARCH_HAS_DEBUG_VM_PGTABLE=y
# CONFIG_DEBUG_VM_PGTABLE is not set
CONFIG_ARCH_HAS_DEBUG_VIRTUAL=y
# CONFIG_DEBUG_MEMORY_INIT is not set
CONFIG_HAVE_ARCH_KASAN=y
CONFIG_HAVE_ARCH_KASAN_VMALLOC=y
CONFIG_CC_HAS_KASAN_GENERIC=y
CONFIG_CC_HAS_WORKING_NOSANITIZE_ADDRESS=y
# CONFIG_KASAN is not set
CONFIG_KASAN_STACK=1
CONFIG_TRACE_IRQFLAGS_SUPPORT=y
CONFIG_EARLY_PRINTK_USB=y
# CONFIG_X86_VERBOSE_BOOTUP is not set
CONFIG_EARLY_PRINTK=y
CONFIG_EARLY_PRINTK_DBGP=y
CONFIG_EARLY_PRINTK_USB_XDBC=y
# CONFIG_EFI_PGT_DUMP is not set
CONFIG_HAVE_MMIOTRACE_SUPPORT=y
CONFIG_IO_DELAY_0XED=y
# CONFIG_IO_DELAY_UDELAY is not set
# CONFIG_IO_DELAY_NONE is not set
CONFIG_PUNIT_ATOM_DEBUG=m
# CONFIG_UNWINDER_ORC is not set
CONFIG_UNWINDER_FRAME_POINTER=y
# CONFIG_UNWINDER_GUESS is not set
# end of x86 Debugging
CONFIG_DEBUG_BUGVERBOSE=y
CONFIG_DYNAMIC_DEBUG_CORE=y
CONFIG_CB710_DEBUG_ASSUMPTIONS=y
CONFIG_PM_DEBUG=y
CONFIG_PM_ADVANCED_DEBUG=y
CONFIG_PM_SLEEP_DEBUG=y
CONFIG_ACPI_EC_DEBUGFS=m
CONFIG_ACPI_DEBUGGER=y
CONFIG_ACPI_DEBUGGER_USER=y
CONFIG_ACPI_DEBUG=y
CONFIG_SLUB_DEBUG=y
CONFIG_IOSF_MBI_DEBUG=y
CONFIG_ARCH_SUPPORTS_DEBUG_PAGEALLOC=y
CONFIG_X86_DEBUGCTLMSR=y
CONFIG_PRINTK_TIME=y
CONFIG_DEBUG_BUGVERBOSE=y
CONFIG_MEMTEST=y
CONFIG_ARCH_HAS_KCOV=y
CONFIG_CC_HAS_SANCOV_TRACE_PC=y
CONFIG_TEST_BPF=m
CONFIG_TEST_BLACKHOLE_DEV=m
CONFIG_RUNTIME_TESTING_MENU=y
CONFIG_NOTIFIER_ERROR_INJECTION=m
CONFIG_PM_NOTIFIER_ERROR_INJECT=m
CONFIG_UNWINDER_ORC=y
CONFIG_X86_DEBUG_FPU=y
CONFIG_HAVE_MMIOTRACE_SUPPORT=y
CONFIG_TRACE_IRQFLAGS_SUPPORT=y
```

## kloudos/config/ds_common_defconfig
```kconfig
CONFIG_CC_OPTIMIZE_FOR_SIZE=y
# CONFIG_CC_OPTIMIZE_FOR_PERFORMANCE is not set

CONFIG_PM_DEBUG=n
CONFIG_PM_ADVANCED_DEBUG=n
CONFIG_CGROUP_DEBUG=n
CONFIG_IP_VS_DEBUG=n
CONFIG_DEBUG_DEVRES=n
CONFIG_DEBUG_PREEMPT=n
CONFIG_DEBUG_SPINLOCK=n
CONFIG_DEBUG_ATOMIC_SLEEP=n
CONFIG_DEBUG_CREDENTIALS=n
CONFIG_DRM_DEBUG_DP_MST_TOPOLOGY_REFS=n
CONFIG_DRM_DEBUG_MM=n
CONFIG_DRM_DEBUG_SELFTEST=n
#
# drm/i915 Debugging
#
CONFIG_DRM_I915_WERROR=n
CONFIG_DRM_I915_DEBUG=n
CONFIG_DRM_I915_DEBUG_MMIO=n
CONFIG_DRM_I915_SW_FENCE_DEBUG_OBJECTS=n
CONFIG_DRM_I915_SW_FENCE_CHECK_DAG=n
CONFIG_DRM_I915_DEBUG_GUC=n
CONFIG_DRM_I915_SELFTEST=n
CONFIG_DRM_I915_LOW_LEVEL_TRACEPOINTS=n
CONFIG_DRM_I915_DEBUG_VBLANK_EVADE=n
CONFIG_DRM_I915_DEBUG_RUNTIME_PM=n
CONFIG_DRM_I915_PCIE_STRICT_WRITE_ORDERING=n
CONFIG_DRM_I915_DEBUG_CONTIGUOUS=n
CONFIG_DRM_I915_DUMP_PPGTT=n
# end of drm/i915 Debugging

CONFIG_DEBUG_KERNEL=n
CONFIG_DEBUG_MISC=n
CONFIG_DRM_I915_DEBUG_GEM=n
CONFIG_DEBUG_FS=n
CONFIG_DEBUG_INFO=n

CONFIG_DEBUG_BOOT_PARAMS=n
CONFIG_PUNIT_ATOM_DEBUG=n
CONFIG_SLUB_DEBUG_ON=n
CONFIG_DEBUG_STACKOVERFLOW=n

CONFIG_CFG80211_DEBUGFS=n
CONFIG_MAC80211_DEBUG_MENU=n
CONFIG_MAC80211_VERBOSE_DEBUG=n
CONFIG_IWLWIFI_DEBUG=n
CONFIG_IWLWIFI_DEBUGFS=n
CONFIG_ATH10K_DEBUG=n
CONFIG_ATH10K_DEBUGFS=n
CONFIG_ATH9K_DEBUGFS=n
CONFIG_ATH_DEBUG=n
CONFIG_RTLWIFI_DEBUG=n
CONFIG_WILCO_EC_DEBUGFS=n
CONFIG_DEBUG_GPIO=n

CONFIG_V4L_TEST_DRIVERS=n
CONFIG_TEST_ASYNC_DRIVER_PROBE=n
CONFIG_MMC_TEST=n

CONFIG_TEST_KASAN=n
CONFIG_TEST_FIRMWARE=n
CONFIG_TEST_UDELAY=n
CONFIG_TEST_MODULE=n
CONFIG_NL80211_TESTMODE=n
CONFIG_SW_SYNC=n

CONFIG_ARM_PTDUMP=n
CONFIG_ARM_PTDUMP_DEBUGFS=n
CONFIG_ARM64_PTDUMP_DEBUGFS=n
CONFIG_BLK_DEBUG_FS=n
CONFIG_DEBUG_DEVRES=n
CONFIG_DEBUG_WX=n
CONFIG_GENERIC_IRQ_DEBUGFS=n
CONFIG_IRQ_DOMAIN_DEBUG=n
CONFIG_PM_TEST_SUSPEND=n
CONFIG_PM_SLEEP_DEBUG=n
CONFIG_DPM_WATCHDOG=n
CONFIG_PM_TRACE=n
CONFIG_PM_TRACE_RTC=n
CONFIG_DRM_CIRRUS_QEMU=n
CONFIG_DRM_VIRTIO_GPU=n
CONFIG_VIRTIO_DMA_SHARED_BUFFER=n
CONFIG_VIRTIO_INPUT=n
CONFIG_VIRTIO=n
CONFIG_BLK_MQ_VIRTIO=n
CONFIG_VIRTIO_VSOCKETS_COMMON=n
CONFIG_CRYPTO_DEV_VIRTIO=n
CONFIG_VETH=n
CONFIG_VIRTIO_NET=n
CONFIG_VIRTIO_CONSOLE=n
CONFIG_HW_RANDOM_VIRTIO=n
CONFIG_TCG_VIRTIO_VTPM=n
CONFIG_DRM_VIRTIO_GPU=n
CONFIG_VIRTIO_PCI=n
CONFIG_VIRTIO_PMEM=n
CONFIG_VIRTIO_BALLOON=n
CONFIG_VIRTIO_MMIO=n
CONFIG_VIRTIO_MMIO_CMDLINE_DEVICES=n
CONFIG_VIRTIO_WL=n
CONFIG_VIRTIO_FS=n
CONFIG_VSOCKETS=n
CONFIG_VIRTIO_VSOCKETS=n
CONFIG_NET_9P_VIRTIO=n
CONFIG_VIRTIO_BLK=n
CONFIG_SCSI_VIRTIO=n
CONFIG_HAVE_KVM=n
CONFIG_DRM_I915_GVT_KVMGT=n
CONFIG_HAVE_KVM_ARCH_TLB_FLUSH_ALL=n
CONFIG_HAVE_KVM_CPU_RELAX_INTERCEPT=n
CONFIG_HAVE_KVM_EVENTFD=n
CONFIG_HAVE_KVM_INVALID_WAKEUPS=n
CONFIG_HAVE_KVM_IRQCHIP=n
CONFIG_HAVE_KVM_IRQFD=n
CONFIG_HAVE_KVM_IRQ_BYPASS=n
CONFIG_HAVE_KVM_IRQ_ROUTING=n
CONFIG_HAVE_KVM_MSI=n
CONFIG_HAVE_KVM_NO_POLL=n
CONFIG_HAVE_KVM_VCPU_ASYNC_IOCTL=n
CONFIG_HAVE_KVM_VCPU_RUN_PID_CHANGE=n
CONFIG_KVM_AMD=n
CONFIG_KVM_AMD_SEV=n
CONFIG_KVM_ARM_PMU=n
CONFIG_KVM_ASYNC_PF=n
CONFIG_KVM_ASYNC_PF_SYNC=n
CONFIG_KVM_BOOK3S_64=n
CONFIG_KVM_BOOK3S_64_HANDLER=n
CONFIG_KVM_BOOK3S_64_HV=n
CONFIG_KVM_BOOK3S_64_PR=n
CONFIG_KVM_BOOK3S_HANDLER=n
CONFIG_KVM_BOOK3S_HV_EXIT_TIMING=n
CONFIG_KVM_BOOK3S_HV_POSSIBLE=n
CONFIG_KVM_BOOK3S_PR_POSSIBLE=n
CONFIG_KVM_COMPAT=n
CONFIG_KVM_GENERIC_DIRTYLOG_READ_PROTECT=n
CONFIG_KVM_GUEST=n
CONFIG_KVM_INDIRECT_VECTORS=n
CONFIG_KVM_INTEL=n
CONFIG_KVM_MMIO=n
CONFIG_KVM_MMU_AUDIT=n
CONFIG_KVM_S390_UCONTROL=n
CONFIG_KVM_VFIO=n
CONFIG_KVM_WERROR=n
CONFIG_KVM_XICS=n
CONFIG_KVM_XIVE=n
CONFIG_VIRTWL=n
CONFIG_VIRTUALIZATION=n
CONFIG_HYPERVISOR_GUEST=n
CONFIG_PARAVIRT=n
```
